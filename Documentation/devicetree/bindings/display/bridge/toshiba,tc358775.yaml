## Documentation/devicetree/bindings/display/bridge/toshiba,tc358775.yaml
```yaml
# SPDX-License-Identifier: GPL-2.0
%YAML 1.2
---
$id: http://devicetree.org/schemas/display/bridge/toshiba,tc358775.yaml#
$schema: http://devicetree.org/meta-schemas/core.yaml#

title: Toshiba TC358775 DSI to LVDS bridge bindings

maintainers:
 - Vinay Simha BN <simhavcs@gmail.com>

description: |
 This binding supports DSI to LVDS bridge TC358775

properties:
  compatible:
    const: toshiba,tc358775

  reg:
    maxItems: 1
    description: i2c address of the bridge, 0x0f

  vdd-supply:
    maxItems: 1
    description:  1.2V LVDS Power Supply

  vddio-supply:
    maxItems: 1
    description: 1.8V IO Power Supply

  stby-gpios:
    maxItems: 1
    description: Standby pin, Low active

  reset-gpios:
    maxItems: 1
    description: Hardware reset, Low active

  ports:
    type: object
    description:
      A node containing input and output port nodes with endpoint definitions
      as documented in
      Documentation/devicetree/bindings/media/video-interfaces.txt
    properties:
      "#address-cells":
        const: 1

      "#size-cells":
        const: 0

      port@0:
        type: object
        description: |
          DSI Input. The remote endpoint phandle should be a
          reference to a valid mipi_dsi_host device node.

      port@1:
        type: object
        description: |
          Video port for LVDS output (panel or connector).

      port@2:
        type: object
        description: |
          Video port for Dual link LVDS output (panel or connector).

    required:
      - port@0
      - port@1

required:
 - compatible
 - reg
 - vdd-supply
 - vddio-supply
 - stby-gpios
 - reset-gpios
 - ports

examples:
 - |
    #include <dt-bindings/gpio/gpio.h>

    i2c@78b8000 {
        /* On High speed expansion */
        label = "HS-I2C2";
        reg = <0x078b8000 0x500>;
        #address-cells = <1>;
        #size-cells = <0>;

        tc_bridge: bridge@f {
            compatible = "toshiba,tc358775";
            reg = <0x0f>;

            vdd-supply = <&pm8916_l2>;
            vddio-supply = <&pm8916_l6>;

            stby-gpio = <&msmgpio 99 GPIO_ACTIVE_LOW>;
            reset-gpio = <&msmgpio 72 GPIO_ACTIVE_LOW>;

            ports {
                #address-cells = <1>;
                #size-cells = <0>;

                port@0 {
                    reg = <0>;
                    d2l_in_test: endpoint {
                        remote-endpoint = <&dsi0_out>;
                    };
                };

                port@1 {
                    reg = <1>;
                    lvds_out: endpoint {
                        remote-endpoint = <&panel_in>;
                    };
                };
            };
        };
    };

    panel: auo,b101xtn01 {
        compatible = "auo,b101xtn01", "panel-lvds";
        power-supply = <&pm8916_l14>;

        width-mm = <223>;
        height-mm = <125>;

        data-mapping = "jeida-24";

        panel-timing {
            /* 1366x768 @60Hz */
            clock-frequency = <72000000>;
            hactive = <1366>;
            vactive = <768>;
            hsync-len = <70>;
            hfront-porch = <20>;
            hback-porch = <0>;
            vsync-len = <42>;
            vfront-porch = <14>;
            vback-porch = <0>;
        };

        port {
            panel_in: endpoint {
                remote-endpoint = <&lvds0_out>;
            };
        };
    };

    dsi@1a98000 {
        reg = <0x1a98000 0x25c>;
        reg-names = "dsi_ctrl";

        ports {
            #address-cells = <1>;
            #size-cells = <0>;
            port@1 {
                reg = <1>;
                dsi0_out: endpoint {
                    remote-endpoint = <&d2l_in_test>;
                        data-lanes = <0 1 2 3>;
                };
             };
         };
     };

 - |
    i2c@78b8000 {
        /* On High speed expansion */
        label = "HS-I2C2";
        reg = <0x078b8000 0x500>;
        #address-cells = <1>;
        #size-cells = <0>;

        tc_bridge_dual: bridge@f {
            compatible = "toshiba,tc358775";
            reg = <0x0f>;

            vdd-supply = <&pm8916_l2>;
            vddio-supply = <&pm8916_l6>;

            stby-gpio = <&msmgpio 99 GPIO_ACTIVE_LOW>;
            reset-gpio = <&msmgpio 72 GPIO_ACTIVE_LOW>;

            ports {
                #address-cells = <1>;
                #size-cells = <0>;

                port@0 {
                    reg = <0>;
                    d2l_in_dual: endpoint {
                        remote-endpoint = <&dsi0_out_dual>;
                    };
                };

                port@1 {
                    reg = <1>;
                    lvdsi0_out: endpoint {
                        remote-endpoint = <&panel_in0>;
                    };
                };

                port@2 {
                    reg = <2>;
                    lvds1_out: endpoint {
                        remote-endpoint = <&panel_in1>;
                    };
                };
            };
        };
    };

    dual_link: panel-lvds {
        compatible = "advantech,idk-2121wr", "panel-lvds";

        width-mm = <476>;
        height-mm = <268>;

        data-mapping = "vesa-24";

        panel-timing {
            clock-frequency = <148500000>;
            hactive = <1920>;
            vactive = <1080>;
            hsync-len = <44>;
            hfront-porch = <88>;
            hback-porch = <148>;
            vfront-porch = <4>;
            vback-porch = <36>;
            vsync-len = <5>;
        };

        ports {
            #address-cells = <1>;
            #size-cells = <0>;

            port@0 {
                reg = <0>;
                dual-lvds-odd-pixels;
                panel_in0: endpoint {
                    remote-endpoint = <&lvds0_out>;
                };
            };

            port@1 {
                reg = <1>;
                dual-lvds-even-pixels;
                panel_in1: endpoint {
                    remote-endpoint = <&lvds1_out>;
                };
            };
        };
    };

    dsi@1a98000 {
        reg = <0x1a98000 0x25c>;
        reg-names = "dsi_ctrl";

        ports {
            #address-cells = <1>;
            #size-cells = <0>;
            port@1 {
                reg = <1>;
                dsi0_out_dual: endpoint {
                    remote-endpoint = <&d2l_in_dual>;
                        data-lanes = <0 1 2 3>;
                };
             };
         };
     };
...
```

## Documentation/devicetree/bindings/display/bridge/toshiba-tc358775.yaml
```yaml
# SPDX-License-Identifier: GPL-2.0
%YAML 1.2
---
$id: http://devicetree.org/schemas/display/bridge/toshiba-tc358775.yaml#
$schema: http://devicetree.org/meta-schemas/core.yaml#


title: Toshiba TC358775 DSI to LVDS bridge bindings

maintainers:
	- Vinay Simha BN <simhavcs@gmail.com>

description: |
	This binding supports DSI to LVDS bridge TC358775

properties:
 compatible:
	const: toshiba,tc358775

 reg:
   maxItems: 1
   description: i2c address of the bridge, 0x0f

 tc, dsi-lanes: 1
   maxItems: 1
   description: Number of DSI data lanes connected to the DSI host. It should
  be one of 1, 2, 3 or 4.

 vdd-supply:
   maxItems: 1
   description:  1.2V LVDS Power Supply

 vddio-supply:
   maxItems: 1
   description: 1.8V IO Power Supply

 stby-gpios:
   maxItems: 1
   description: Standby pin, Low active

 reset-gpios:
   maxItems: 1
   description: Hardware reset, Low active

 ports:
   type: object

    properties:
      port@0:
        type: object
        description: |
          DSI Input. The remote endpoint phandle should be a
	  reference to a valid mipi_dsi_host device node.
      port@1:
        type: object
        description: |
          Video port for LVDS output (panel or connector).
      port@2:
        type: object
        description: |
          Video port for Dual link LVDS output (panel or connector).

      required:
      - port@0
      - port@1

      optional:
      - port@2

required:
 - compatible
 - reg
 - dsi-lanes
 - vdd-supply
 - vddio-supply
 - stby-gpios
 - reset-gpios
 - ports

examples:
 - |
   i2c@78b8000 {
	/* On High speed expansion */
	label = "HS-I2C2";
	status = "okay";

	tc_bridge: bridge@f {
		status = "okay";

		compatible = "toshiba,tc358775";
		reg = <0x0f>;

		tc,dsi-lanes = <4>;
		tc,dual-link = <0>;

		vdd-supply = <&pm8916_l2>;
		vddio-supply = <&pm8916_l6>;

		stby-gpio = <&msmgpio 99 GPIO_ACTIVE_LOW>;
		reset-gpio = <&msmgpio 72 GPIO_ACTIVE_LOW>;

		ports {
			#address-cells = <1>;
			#size-cells = <0>;

			port@0 {
				reg = <0>;
				d2l_in: endpoint {
					remote-endpoint = <&dsi0_out>;
				};
			};

			port@1 {
				reg = <1>;
				lvds0_out: endpoint {
					remote-endpoint = <&panel_in0>;
				};
			};

                        /* In case of dual link lvds panel/connector */
			port@2 {
				reg = <2>;
				lvds1_out: endpoint {
					remote-endpoint = <&panel_in1>;
				};
			};
		};
	};
  };

  panel: auo,b101xtn01 {
		status = "okay";
		compatible = "auo,b101xtn01", "panel-lvds";
		power-supply = <&pm8916_l14>;

		width-mm = <223>;
		height-mm = <125>;

		data-mapping = "jeida-24";

		panel-timing {
			/* 1366x768 @60Hz */
			clock-frequency = <72000000>;
			hactive = <1366>;
			vactive = <768>;
			hsync-len = <70>;
			hfront-porch = <20>;
			hback-porch = <0>;
			vsync-len = <42>;
			vfront-porch = <14>;
			vback-porch = <0>;
		};

		port {
			panel_in0: endpoint {
				remote-endpoint = <&lvds0_out>;
			};
		};
 };

 dual_link: panel-lvds {
                compatible = "advantech,idk-2121wr", "panel-lvds";

                width-mm = <476>;
                height-mm = <268>;

                data-mapping = "vesa-24";

                panel-timing {
                        clock-frequency = <148500000>;
                        hactive = <1920>;
                        vactive = <1080>;
                        hsync-len = <44>;
                        hfront-porch = <88>;
                        hback-porch = <148>;
                        vfront-porch = <4>;
                        vback-porch = <36>;
                        vsync-len = <5>;
                };

                ports {
                        #address-cells = <1>;
                        #size-cells = <0>;

                        port@0 {
                                reg = <0>;
                                dual-lvds-odd-pixels;
                                panel_in0: endpoint {
                                        remote-endpoint = <&lvds0_out>;
                                };
                        };

                        port@1 {
                                reg = <1>;
                                dual-lvds-even-pixels;
                                panel_in1: endpoint {
                                        remote-endpoint = <&lvds1_out>;
                                };
                        };
                };
        };

  mdss@1a00000 {
	status = "okay";

	mdp@1a01000 {
		status = "okay";
	};

	dsi@1a98000 {
		status = "okay";
		..
		ports {
			port@1 {
				dsi0_out: endpoint {
					remote-endpoint = <&d2l_in>;
					data-lanes = <0 1 2 3>;
				};
			};
		};
	};

	dsi-phy@1a98300 {
		status = "okay";
		..
	};
 };
```

## Documentation/devicetree/bindings/display/panel/auo,at-t070d61-39ta-b1.txt
```
AUO model AT-T070D61-39TA-B1 800x1280 7" DSI Panel

Required properties:
- compatible: should be "auo,at-t070d61-39ta-b1"
- vcc-supply: phandle of the regulator that provides the supply voltage
  VCC power supply (3.3V)
- reset-gpios: phandle of gpio for reset line
  RESET, HIGH active
- bklt-pwm-gpios: phandle of the gpio for power ic line
  Power IC supply enable, High active

Example:

	dsi0: qcom,mdss_dsi@4700000 {
		panel@0 {
			reg = <0>;
			compatible = "auo,at-t070d61-39ta-b1";

			vcc-supply = <&pm8921_l8>;

			reset-gpios = <&pm8821_mpps 2 GPIO_ACTIVE_HIGH>;
			bklt-pwm-gpios = <&tlmm_pinmux 80 GPIO_ACTIVE_HIGH>;

			port {
				panel_in: endpoint {
					remote-endpoint = <&dsi0_out>;
				};
			};
		};

		ports {
			port@0 {
				dsi0_in: endpoint {
					remote-endpoint = <&mdp_dsi1_out>;
				};
			};

			port@1 {
				dsi0_out: endpoint {
					remote-endpoint = <&panel_in>;
					data-lanes = <0 1 2 3>;
				};
			};
		};
	};
```
